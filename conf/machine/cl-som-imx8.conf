## conf/machine/cl-som-imx8.conf
```bitbake
#@TYPE: Machine
#@NAME: CompuLab i.MX8MQ Evaluation Kit
#@SOC: i.MX8MQ
#@DESCRIPTION: Machine configuration for CompuLab i.MX8MQ EVK
#@MAINTAINER: CompuLab <compulab@compulab.com>

MACHINEOVERRIDES =. "mx8mq:"

require conf/machine/include/imx-base.inc
require conf/machine/include/arm/armv8a/tune-cortexa53.inc

UBOOT_ARCH = "arm64"

# Mainline BSP defaults to "generic" cortexa53 configuration,
# adjust it here to include crypto extension which enables
# inline NEON and FPU code generation
DEFAULTTUNE:use-mainline-bsp = "cortexa53-crypto"

MACHINE_FEATURES += "pci wifi bluetooth bcm43455 bcm4356 nxp8997-pcie nxp8997-sdio nxp9098-pcie nxp9098-sdio"
MACHINE_FEATURES:append:use-nxp-bsp = " optee bcm4359"

MACHINE_SOCARCH_FILTER:append:mx8mq = " virtual/libopenvg virtual/libgles1 virtual/libgles2 virtual/egl virtual/mesa virtual/libgl virtual/libg2d"

#KERNEL_DEVICETREE:append:use-nxp-bsp = "\
#    compulab/cl-som-imx8.dtb            \
#    compulab/sbc-imx8.dtb               \
#    compulab/sbc-imx8-thermal.dtb       \
#    compulab/sbc-imx8-bluetooth.dtb     \
#    compulab/sbc-imx8-m4.dtb            \
#    compulab/sbc-imx8-no-edid.dtb       \
#    compulab/sbc-imx8-no-wp.dtb         \
#    compulab/sbc-imx8-emmc-low.dtb      \
#    compulab/sbc-imx8-lvds-lcdif.dtb    \
#    compulab/sbc-imx8-lvds-dcss.dtb     \
#    "

KERNEL_DEVICETREE:append:use-nxp-bsp = "\
    compulab/cl-som-imx8.dtb            \
    "


IMX_DEFAULT_BOOTLOADER:use-nxp-bsp = "u-boot-imx"
IMX_DEFAULT_BOOTLOADER:use-mainline-bsp = "u-boot-fslc"

UBOOT_SUFFIX = "bin"

UBOOT_CONFIG ??= "sd"
UBOOT_CONFIG[sd] = "cl-som-imx8_defconfig,sdcard"
UBOOT_CONFIG[mfgtool] = "cl-som-imx8_defconfig"

SPL_BINARY = "spl/u-boot-spl.bin"

# Set DDR FIRMWARE
#DDR_FIRMWARE_NAME = "\
#    lpddr4_pmu_train_1d_imem.bin    \
#    lpddr4_pmu_train_1d_dmem.bin    \
#    lpddr4_pmu_train_2d_imem.bin    \
#    lpddr4_pmu_train_2d_dmem.bin    \
#    "

# Set u-boot DTB
UBOOT_DTB_NAME = "cl-som-imx8.dtb"

# Set ATF platform name
ATF_PLATFORM = "imx8mq"

# Set imx-mkimage boot target
IMXBOOT_TARGETS = "flash_evk flash_evk_no_hdmi flash_dp_evk"
IMX_BOOT_SOC_TARGET = "iMX8M"

# Add support for Syslinux to mainline BSP.
# U-Boot has the Distro Boot mode enabled by default, which
# require that either Syslinux to be enabled, or a boot script
# to be used to define the boot process.
# We opt-in for Syslinux, since it is designated as a preferred
# distro boot mode according to the U-Boot documentation.
UBOOT_EXTLINUX:use-mainline-bsp = "1"
UBOOT_EXTLINUX_LABELS:use-mainline-bsp = "default"
UBOOT_EXTLINUX_DEFAULT_LABEL:use-mainline-bsp = "i.MX8M Quad EVK"

UBOOT_EXTLINUX_MENU_DESCRIPTION:default:use-mainline-bsp = "i.MX8M Quad EVK"
UBOOT_EXTLINUX_FDT:default:use-mainline-bsp     = "../cl-som-imx8.dtb"
UBOOT_EXTLINUX_CONSOLE:default:use-mainline-bsp = "console=${console}"
UBOOT_EXTLINUX_ROOT:default:use-mainline-bsp    ??= "root=/dev/mmcblk1p2"

# Add extlinux.conf to the lis of files, which are deployed onto the
# boot partition
IMAGE_BOOT_FILES:append:use-mainline-bsp = " extlinux.conf;extlinux/extlinux.conf"

# Set Serial console
SERIAL_CONSOLES = "115200;ttymxc0"

IMAGE_BOOTLOADER = "imx-boot"

LOADADDR = ""
UBOOT_MAKE_TARGET = ""
IMX_BOOT_SEEK = "33"

OPTEE_BIN_EXT = "8mq"

# Add additional firmware
MACHINE_FIRMWARE:append = " linux-firmware-iwlwifi-8265 linux-firmware-ibt firmware-imx-vpu-imx8 "
MACHINE_FIRMWARE:remove = " linux-firmware-ath10k"

#PLATFORM_FLAVOR_cl-som-imx8 = "mx8mqevk"

KERNEL_CLASSES  = " kernel-fitimage "
KERNEL_IMAGETYPES = "fitImage"

#
# Use gstreamer 1.14 from meta-freescale
#PREFERRED_VERSION_gstreamer1.0 ?= "1.14.imx"
#PREFERRED_VERSION_gstreamer1.0-plugins-base ?= "1.14.imx"
#PREFERRED_VERSION_gstreamer1.0-plugins-good ?= "1.14.imx"
#PREFERRED_VERSION_gstreamer1.0-plugins-bad ?= "1.14.imx"
#PREFERRED_VERSION_gstreamer1.0-libav ?= "1.14.0"
```
